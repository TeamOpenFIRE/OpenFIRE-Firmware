/*!
 * @file OpenFIREdisplay.h
 * @brief Macros for lightgun HUD display (primarily for SSD1306 OLED modules).
 *
 * @copyright That One Seong, 2024
 * @copyright GNU Lesser General Public License
 */

#ifndef _OPENFIREDISPLAY_H_
#define _OPENFIREDISPLAY_H_

#include <stdint.h>
#include <Adafruit_SSD1306.h>
#include <Adafruit_SH110X.h>

#include "OpenFIREDefines.h"
#include "boards/OpenFIREshared.h"

#define SCREEN_WIDTH 128
#define SCREEN_HEIGHT 64

/* 
    Filthy hack to get around lack of a single multi-display library,
    is we simply wrap around every command used in the display code
    to point to the correct display type.
    ATM, this is currently made with Adafruit_GFX-compatible display
    libraries in mind.
*/
class Adafruit_MultiDisplay {
public:
    OF_Const::I2COLEDTypes_e i2cDispType;
    Adafruit_SSD1306 *display1306 = nullptr;
    Adafruit_SH1106G *display1106 = nullptr;
    Adafruit_SH1107 *display1107 = nullptr;

    // constructor
    Adafruit_MultiDisplay(TwoWire *twi, const OF_Const::I2COLEDTypes_e &displayType)
        : i2cDispType(displayType)
    {
        switch(displayType) {
        case OF_Const::I2Cdisp_SSD1306:
            display1306 = new Adafruit_SSD1306(SCREEN_WIDTH, SCREEN_HEIGHT, twi, -1, 1000000);
            break;
        case OF_Const::I2Cdisp_SH1106:
            display1106 = new Adafruit_SH1106G(SCREEN_WIDTH, SCREEN_HEIGHT, twi, -1, 1000000);
            break;
        case OF_Const::I2Cdisp_SH1107:
            display1107 = new Adafruit_SH1107(SCREEN_WIDTH, SCREEN_HEIGHT, twi, -1, 1000000);
            break;
        default: break;
        }
    }

    // SPI constructor
    /* TODO: hook up in a way that actually works
    Adafruit_MultiDisplay(SPIClassRP2040 *spi, const int &csn const int &dc, const int &reset, const OF_Const::SPIOLEDTypes_e &displayType)
        : spiDispType(displayType)
    {
        switch(displayType) {
        case OF_Const::displaySSD1306_SPI:
            display1306 = new Adafruit_SSD1306(SCREEN_WIDTH, SCREEN_HEIGHT, spi, dc, reset, csn);
            break;
        case OF_Const::displaySH1106_SPI:
            display1106 = new Adafruit_SH1106G(SCREEN_WIDTH, SCREEN_HEIGHT, spi, dc, reset, csn);
            break;
        case OF_Const::displaySH1107_SPI:
            display1107 = new Adafruit_SH1107(SCREEN_WIDTH, SCREEN_HEIGHT, spi, dc, reset, csn);
            break;
        default: break;
        }
    }
    */

    // destructor: cleanup
    ~Adafruit_MultiDisplay() {
        switch(i2cDispType) {
        case OF_Const::I2Cdisp_SSD1306:
            delete display1306;
            display1306 = nullptr;
            break;
        case OF_Const::I2Cdisp_SH1106:
            delete display1106;
            display1106 = nullptr;
            break;
        case OF_Const::I2Cdisp_SH1107:
            delete display1107;
            display1107 = nullptr;
            break;
        default: break;
        }
    }

    bool begin(const bool altI2Caddr) {
        switch(i2cDispType) {
            case OF_Const::I2Cdisp_SSD1306:
                return display1306->begin(SSD1306_SWITCHCAPVCC, altI2Caddr ? 0x3D : 0x3C);
            case OF_Const::I2Cdisp_SH1106:
                return display1106->begin();
            case OF_Const::I2Cdisp_SH1107:
                return display1107->begin();
            default: return false;
        }
    }

    void display() {
        #ifdef SERIAL_DEBUG
        unsigned long preDispTS = millis();
        #endif // SERIAL_DEBUG
        switch(i2cDispType) {
            case OF_Const::I2Cdisp_SSD1306:
                display1306->display(); break;
            case OF_Const::I2Cdisp_SH1106:
                display1106->display(); break;
            case OF_Const::I2Cdisp_SH1107:
                display1107->display(); break;
            default: break;
        }
        #ifdef SERIAL_DEBUG
        Serial.printf("Display() took %d ms\n", millis() - preDispTS);
        #endif // SERIAL_DEBUG
    }

    void invertDisplay(const bool &i) {
        switch(i2cDispType) {
            case OF_Const::I2Cdisp_SSD1306:
                display1306->invertDisplay(i); break;
            case OF_Const::I2Cdisp_SH1106:
                display1106->invertDisplay(i); break;
            case OF_Const::I2Cdisp_SH1107:
                display1107->invertDisplay(i); break;
            default: break;
        }
    }

    void clearDisplay() {
        switch(i2cDispType) {
            case OF_Const::I2Cdisp_SSD1306:
                display1306->clearDisplay(); break;
            case OF_Const::I2Cdisp_SH1106:
                display1106->clearDisplay(); break;
            case OF_Const::I2Cdisp_SH1107:
                display1107->clearDisplay(); break;
            default: break;
        }
    }

    // only SSD1306 has a predefined dim function (which sets contrast to 0x8F), with no public "set contrast" method
    // SH1106 also seems to have virtually no range in contrast - 0x2F seems to have the same effect as 0x01
    void dim(const bool &dim) {
        switch(i2cDispType) {
            case OF_Const::I2Cdisp_SSD1306:
                display1306->dim(dim); break;
            case OF_Const::I2Cdisp_SH1106:
                display1106->setContrast(dim ? 0x01 : 0xFF);
                break;
            case OF_Const::I2Cdisp_SH1107:
                display1107->setContrast(dim ? 0x2F : 0x4F);
                break;
            default: break;
        }
    }

    void cp437(const bool &x) {
        switch(i2cDispType) {
            case OF_Const::I2Cdisp_SSD1306:
                display1306->cp437(x); break;
            case OF_Const::I2Cdisp_SH1106:
                display1106->cp437(x); break;
            case OF_Const::I2Cdisp_SH1107:
                display1107->cp437(x); break;
            default: break;
        }
    }

    void drawFastVLine(const int16_t &x, const int16_t &y, const int16_t &h, const uint16_t &color) {
        switch(i2cDispType) {
            case OF_Const::I2Cdisp_SSD1306:
                display1306->drawFastVLine(x, y, h, color); break;
            case OF_Const::I2Cdisp_SH1106:
                display1106->drawFastVLine(x, y, h, color); break;
            case OF_Const::I2Cdisp_SH1107:
                display1107->drawFastVLine(x, y, h, color); break;
            default: break;
        }
    }

    void drawFastHLine(const int16_t &x, const int16_t &y, const int16_t &w, const uint16_t &color) {
        switch(i2cDispType) {
            case OF_Const::I2Cdisp_SSD1306:
                display1306->drawFastHLine(x, y, w, color); break;
            case OF_Const::I2Cdisp_SH1106:
                display1106->drawFastHLine(x, y, w, color); break;
            case OF_Const::I2Cdisp_SH1107:
                display1107->drawFastHLine(x, y, w, color); break;
            default: break;
        }
    }

    void fillRect(const int16_t &x, const int16_t &y, const int16_t &w, const int16_t &h, const uint16_t &color) {
        switch(i2cDispType) {
            case OF_Const::I2Cdisp_SSD1306:
                display1306->fillRect(x, y, w, h, color); break;
            case OF_Const::I2Cdisp_SH1106:
                display1106->fillRect(x, y, w, h, color); break;
            case OF_Const::I2Cdisp_SH1107:
                display1107->fillRect(x, y, w, h, color); break;
            default: break;
        }
    }

    void fillCircle(const int16_t &x, const int16_t &y, const int16_t &r, const uint16_t &color) {
        switch(i2cDispType) {
            case OF_Const::I2Cdisp_SSD1306:
                display1306->fillCircle(x, y, r, color); break;
            case OF_Const::I2Cdisp_SH1106:
                display1106->fillCircle(x, y, r, color); break;
            case OF_Const::I2Cdisp_SH1107:
                display1107->fillCircle(x, y, r, color); break;
            default: break;
        }
    }

    void fillScreen(const uint16_t &color) {
        switch(i2cDispType) {
            case OF_Const::I2Cdisp_SSD1306:
                display1306->fillScreen(color); break;
            case OF_Const::I2Cdisp_SH1106:
                display1106->fillScreen(color); break;
            case OF_Const::I2Cdisp_SH1107:
                display1107->fillScreen(color); break;
            default: break;
        }
    }

    void drawLine(const int16_t &x0, const int16_t &y0, const int16_t &x1, const int16_t &y1, const uint16_t &color) {
        switch(i2cDispType) {
            case OF_Const::I2Cdisp_SSD1306:
                display1306->drawLine(x0, y0, x1, y1, color); break;
            case OF_Const::I2Cdisp_SH1106:
                display1106->drawLine(x0, y0, x1, y1, color); break;
            case OF_Const::I2Cdisp_SH1107:
                display1107->drawLine(x0, y0, x1, y1, color); break;
            default: break;
        }
    }

    void drawRect(const int16_t &x, const int16_t &y, const int16_t &w, const int16_t &h, const uint16_t &color) {
        switch(i2cDispType) {
            case OF_Const::I2Cdisp_SSD1306:
                display1306->drawRect(x, y, w, h, color); break;
            case OF_Const::I2Cdisp_SH1106:
                display1106->drawRect(x, y, w, h, color); break;
            case OF_Const::I2Cdisp_SH1107:
                display1107->drawRect(x, y, w, h, color); break;
            default: break;
        }
    }

    void drawBitmap(const int16_t &x, const int16_t &y, const uint8_t bitmap[], const int16_t &w, const int16_t &h, const uint16_t &color) {
        switch(i2cDispType) {
            case OF_Const::I2Cdisp_SSD1306:
                display1306->drawBitmap(x, y, bitmap, w, h, color); break;
            case OF_Const::I2Cdisp_SH1106:
                display1106->drawBitmap(x, y, bitmap, w, h, color); break;
            case OF_Const::I2Cdisp_SH1107:
                display1107->drawBitmap(x, y, bitmap, w, h, color); break;
            default: break;
        }
    }

    void drawBitmap(const int16_t &x, const int16_t &y, uint8_t *bitmap, const int16_t &w, const int16_t &h, const uint16_t &color) {
        switch(i2cDispType) {
            case OF_Const::I2Cdisp_SSD1306:
                display1306->drawBitmap(x, y, bitmap, w, h, color); break;
            case OF_Const::I2Cdisp_SH1106:
                display1106->drawBitmap(x, y, bitmap, w, h, color); break;
            case OF_Const::I2Cdisp_SH1107:
                display1107->drawBitmap(x, y, bitmap, w, h, color); break;
            default: break;
        }
    }

    void setTextSize(const uint8_t &s) {
        switch(i2cDispType) {
            case OF_Const::I2Cdisp_SSD1306:
                display1306->setTextSize(s); break;
            case OF_Const::I2Cdisp_SH1106:
                display1106->setTextSize(s); break;
            case OF_Const::I2Cdisp_SH1107:
                display1107->setTextSize(s); break;
            default: break;
        }
    }

    void setFont(const GFXfont *f = NULL) {
        switch(i2cDispType) {
            case OF_Const::I2Cdisp_SSD1306:
                display1306->setFont(f); break;
            case OF_Const::I2Cdisp_SH1106:
                display1106->setFont(f); break;
            case OF_Const::I2Cdisp_SH1107:
                display1107->setFont(f); break;
            default: break;
        }
    }

    void setCursor(const int16_t &x, const int16_t &y) {
        switch(i2cDispType) {
            case OF_Const::I2Cdisp_SSD1306:
                display1306->setCursor(x, y); break;
            case OF_Const::I2Cdisp_SH1106:
                display1106->setCursor(x, y); break;
            case OF_Const::I2Cdisp_SH1107:
                display1107->setCursor(x, y); break;
            default: break;
        }
    }

    void setTextColor(const uint16_t &c) {
        switch(i2cDispType) {
            case OF_Const::I2Cdisp_SSD1306:
                display1306->setTextColor(c); break;
            case OF_Const::I2Cdisp_SH1106:
                display1106->setTextColor(c); break;
            case OF_Const::I2Cdisp_SH1107:
                display1107->setTextColor(c); break;
            default: break;
        }
    }

    void setTextColor(const uint16_t &c, const uint16_t &bg) {
        switch(i2cDispType) {
            case OF_Const::I2Cdisp_SSD1306:
                display1306->setTextColor(c, bg); break;
            case OF_Const::I2Cdisp_SH1106:
                display1106->setTextColor(c, bg); break;
            case OF_Const::I2Cdisp_SH1107:
                display1107->setTextColor(c, bg); break;
            default: break;
        }
    }

    void setTextWrap(const bool &w) {
        switch(i2cDispType) {
            case OF_Const::I2Cdisp_SSD1306:
                display1306->setTextWrap(w); break;
            case OF_Const::I2Cdisp_SH1106:
                display1106->setTextWrap(w); break;
            case OF_Const::I2Cdisp_SH1107:
                display1107->setTextWrap(w); break;
            default: break;
        }
    }

    void print(const char *str) {
        switch(i2cDispType) {
            case OF_Const::I2Cdisp_SSD1306:
                display1306->print(str); break;
            case OF_Const::I2Cdisp_SH1106:
                display1106->print(str); break;
            case OF_Const::I2Cdisp_SH1107:
                display1107->print(str); break;
            default: break;
        }
    }

    void print(const int &str) {
        switch(i2cDispType) {
            case OF_Const::I2Cdisp_SSD1306:
                display1306->print(str); break;
            case OF_Const::I2Cdisp_SH1106:
                display1106->print(str); break;
            case OF_Const::I2Cdisp_SH1107:
                display1107->print(str); break;
            default: break;
        }
    }

    void println(const char *str) {
        switch(i2cDispType) {
            case OF_Const::I2Cdisp_SSD1306:
                display1306->println(str); break;
            case OF_Const::I2Cdisp_SH1106:
                display1106->println(str); break;
            case OF_Const::I2Cdisp_SH1107:
                display1107->println(str); break;
            default: break;
        }
    }

    int16_t getCursorX() {
        switch(i2cDispType) {
            case OF_Const::I2Cdisp_SSD1306:
                return display1306->getCursorX();
            case OF_Const::I2Cdisp_SH1106:
                return display1106->getCursorX();
            case OF_Const::I2Cdisp_SH1107:
                return display1107->getCursorX();
            default: return 0;
        }
    }

    int16_t getCursorY() {
        switch(i2cDispType) {
            case OF_Const::I2Cdisp_SSD1306:
                return display1306->getCursorY();
            case OF_Const::I2Cdisp_SH1106:
                return display1106->getCursorY();
            case OF_Const::I2Cdisp_SH1107:
                return display1107->getCursorY();
            default: return 0;
        }
    }

    bool getPixel(const int16_t &x, const int16_t &y) {
        switch(i2cDispType) {
            case OF_Const::I2Cdisp_SSD1306:
                return display1306->getPixel(x, y);
            case OF_Const::I2Cdisp_SH1106:
                return display1106->getPixel(x, y);
            case OF_Const::I2Cdisp_SH1107:
                return display1107->getPixel(x, y);
            default: return false;
        }
    }

    void getTextBounds(const char *str, const int16_t &x, const int16_t &y, int16_t *x1, int16_t *y1, uint16_t *w, uint16_t *h) {
        switch(i2cDispType) {
            case OF_Const::I2Cdisp_SSD1306:
                display1306->getTextBounds(str, x, y, x1, y1, w, h); break;
            case OF_Const::I2Cdisp_SH1106:
                display1106->getTextBounds(str, x, y, x1, y1, w, h); break;
            case OF_Const::I2Cdisp_SH1107:
                display1107->getTextBounds(str, x, y, x1, y1, w, h); break;
            default: break;
        }
    }
};

class ExtDisplay {
public:
    /// @brief Attempt to start display using current pin numbers from OF_Prefs
    /// @return success (true) or fail (false)
    bool Begin();

    /// @brief Cleanup and delete current OLED object
    /// @details This is needed to ensure the wire object is cleaned up
    void Stop();

    /// @brief Update top panel with either a string of 22 characters, or a combination of text prefix and a profile name
    /// @details Prefix should only have up to seven characters, to prevent the profile name being cutoff
    void TopPanelUpdate(const char *, const char * = nullptr);

    /// @brief Clear screen for different gun modes
    void ScreenModeChange(const int &screenMode, const bool &isAnalog = false);

    /// @brief Perform maintenance operations (WIP)
    /// @details For when values aren't being updated, but still want to change something on the screen
    /// (i.e. small text printouts when health/ammo empty)
    void IdleOps();

    /// @brief Draw seen points here
    /// @details Should ONLY be used in scenarios where the mouse isn't being updated, i.e. calibration.
    ///          Arguments here point to the original arrays of seen coords [4]
    void DrawVisibleIR(int *pointX, int *pointY);

    /// @brief Draw hotkey pause mode layout
    void PauseScreenShow(const int &currentProf, const char* name1, const char* name2, const char* name3, const char* name4);

    /// @brief Update simple pause mode list on screen
    void PauseListUpdate(const int &selection);

    /// @brief Update simple pause mode profiles list on screen
    void PauseProfileUpdate(const int &selection, const char* name1, const char* name2, const char* name3, const char* name4);

    /// @brief Print save status message
    void SaveScreen(const int &status);

    /// @brief Update main screen ammo glyphs
    void PrintAmmo(const uint &ammo);

    /// @brief Update main screen life glyphs
    void PrintLife(const uint &life);

    enum ScreenMode_e {
        Screen_None = -1,
        Screen_Init = 0,
        Screen_Normal,
        Screen_Pause,
        Screen_Profile,
        Screen_Saving,
        Screen_SaveSuccess,
        Screen_SaveError,
        Screen_Calibrating,
        Screen_IRTest,
        Screen_Docked,
        Screen_Mamehook_Single,
        Screen_Mamehook_Dual
    };

    enum ScreenPauseList_e {
        ScreenPause_Calibrate = 0,
        ScreenPause_ProfileSelect,
        ScreenPause_Save,
        ScreenPause_Rumble,
        ScreenPause_Solenoid,
        ScreenPause_EscapeKey
    };

    enum ScreenSerialInit_e {
        ScreenSerial_None = 0,
        ScreenSerial_Life,
        ScreenSerial_Ammo,
        ScreenSerial_Both
    };

    Adafruit_MultiDisplay *display = nullptr;

    /// @brief Whether life updates are in lifebar or life glyphs form
    bool lifeBar = false;

    /// @brief Which layout we use for serial mode
    uint8_t serialDisplayType = 0;

    /// @brief Whether MiSTer mode is in use right now or not
    bool mister = false;

private:
    int screenState = Screen_None;

    bool ammoEmpty = false;
    bool lifeEmpty = false;

    uint currentAmmo;
    uint currentLife;

    #define OLED_IDLEUPD_INTERVAL 5000
    #define OLED_TEMPUPD_INTERVAL 750

    // timestamps for periodic tasks in IdleOps()
    unsigned long ammoTimestamp = 0;
    unsigned long lifeTimestamp = 0;
    unsigned long idleTimeStamp = 0;

    #ifdef USES_TEMP
        void ShowTemp();

        uint currentTemp;
        unsigned long idleTempStamp = 0;
        bool showingTemp = false;
        // storage of temperature string
        char tempString[5];
    #endif // USES_TEMP

    #define NUMBER_GLYPH_WIDTH 21
    #define NUMBER_GLYPH_HEIGHT 36
    /// @brief Glyphs for common HUD elements
    static constexpr uint8_t numbers[10][108] = {
        {   // 0
            0x1f, 0xff, 0xc0, 0x3f, 0xff, 0xe0, 0x5f, 0xff, 0xd0, 0xe0, 0x00, 0x78, 0xe0, 0x00, 0xf8, 0xe0,
            0x00, 0xf8, 0xe0, 0x01, 0xb8, 0xe0, 0x01, 0xb8, 0xe0, 0x03, 0x38, 0xe0, 0x03, 0x38, 0xe0, 0x06,
            0x38, 0xe0, 0x06, 0x38, 0xe0, 0x0c, 0x38, 0xe0, 0x0c, 0x38, 0xe0, 0x18, 0x38, 0xe0, 0x18, 0x38,
            0xef, 0xff, 0xb8, 0x5f, 0xff, 0xd0, 0xef, 0xff, 0xb8, 0xe0, 0x60, 0x38, 0xe0, 0x60, 0x38, 0xe0,
            0xc0, 0x38, 0xe0, 0xc0, 0x38, 0xe1, 0x80, 0x38, 0xe1, 0x80, 0x38, 0xe3, 0x00, 0x38, 0xe3, 0x00,
            0x38, 0xe6, 0x00, 0x38, 0xe6, 0x00, 0x38, 0xec, 0x00, 0x38, 0xec, 0x00, 0x38, 0xf8, 0x00, 0x38,
            0xf8, 0x00, 0x38, 0x5f, 0xff, 0xd0, 0x3f, 0xff, 0xe0, 0x1f, 0xff, 0xc0
        },
        {   // 1
            0x00, 0x00, 0x00, 0x00, 0x00, 0x00, 0x00, 0x00, 0x10, 0x00, 0x00, 0x38, 0x00, 0x00, 0x38, 0x00,
            0x00, 0x38, 0x00, 0x00, 0x38, 0x00, 0x00, 0x38, 0x00, 0x00, 0x38, 0x00, 0x00, 0x38, 0x00, 0x00,
            0x38, 0x00, 0x00, 0x38, 0x00, 0x00, 0x38, 0x00, 0x00, 0x38, 0x00, 0x00, 0x38, 0x00, 0x00, 0x38,
            0x00, 0x00, 0x38, 0x00, 0x00, 0x10, 0x00, 0x00, 0x38, 0x00, 0x00, 0x38, 0x00, 0x00, 0x38, 0x00,
            0x00, 0x38, 0x00, 0x00, 0x38, 0x00, 0x00, 0x38, 0x00, 0x00, 0x38, 0x00, 0x00, 0x38, 0x00, 0x00,
            0x38, 0x00, 0x00, 0x38, 0x00, 0x00, 0x38, 0x00, 0x00, 0x38, 0x00, 0x00, 0x38, 0x00, 0x00, 0x38,
            0x00, 0x00, 0x38, 0x00, 0x00, 0x10, 0x00, 0x00, 0x00, 0x00, 0x00, 0x00
        },
        {   // 2
            0x1f, 0xff, 0xc0, 0x3f, 0xff, 0xe0, 0x1f, 0xff, 0xd0, 0x00, 0x00, 0x38, 0x00, 0x00, 0x38, 0x00,
            0x00, 0x38, 0x00, 0x00, 0x38, 0x00, 0x00, 0x38, 0x00, 0x00, 0x38, 0x00, 0x00, 0x38, 0x00, 0x00,
            0x38, 0x00, 0x00, 0x38, 0x00, 0x00, 0x38, 0x00, 0x00, 0x38, 0x00, 0x00, 0x38, 0x00, 0x00, 0x38,
            0x0f, 0xff, 0xb8, 0x5f, 0xff, 0xd0, 0xef, 0xff, 0x80, 0xe0, 0x00, 0x00, 0xe0, 0x00, 0x00, 0xe0,
            0x00, 0x00, 0xe0, 0x00, 0x00, 0xe0, 0x00, 0x00, 0xe0, 0x00, 0x00, 0xe0, 0x00, 0x00, 0xe0, 0x00,
            0x00, 0xe0, 0x00, 0x00, 0xe0, 0x00, 0x00, 0xe0, 0x00, 0x00, 0xe0, 0x00, 0x00, 0xe0, 0x00, 0x00,
            0xe0, 0x00, 0x00, 0x5f, 0xff, 0xc0, 0x3f, 0xff, 0xe0, 0x1f, 0xff, 0xc0
        },
        {   // 3
            0x1f, 0xff, 0xc0, 0x3f, 0xff, 0xe0, 0x1f, 0xff, 0xd0, 0x00, 0x00, 0x38, 0x00, 0x00, 0x38, 0x00,
            0x00, 0x38, 0x00, 0x00, 0x38, 0x00, 0x00, 0x38, 0x00, 0x00, 0x38, 0x00, 0x00, 0x38, 0x00, 0x00,
            0x38, 0x00, 0x00, 0x38, 0x00, 0x00, 0x38, 0x00, 0x00, 0x38, 0x00, 0x00, 0x38, 0x00, 0x00, 0x38,
            0x0f, 0xff, 0xb8, 0x1f, 0xff, 0xd0, 0x0f, 0xff, 0xb8, 0x00, 0x00, 0x38, 0x00, 0x00, 0x38, 0x00,
            0x00, 0x38, 0x00, 0x00, 0x38, 0x00, 0x00, 0x38, 0x00, 0x00, 0x38, 0x00, 0x00, 0x38, 0x00, 0x00,
            0x38, 0x00, 0x00, 0x38, 0x00, 0x00, 0x38, 0x00, 0x00, 0x38, 0x00, 0x00, 0x38, 0x00, 0x00, 0x38,
            0x00, 0x00, 0x38, 0x1f, 0xff, 0xd0, 0x3f, 0xff, 0xe0, 0x1f, 0xff, 0xc0
        },
        {   // 4
            0x00, 0x00, 0x00, 0x00, 0x00, 0x00, 0x40, 0x00, 0x10, 0xe0, 0x00, 0x38, 0xe0, 0x00, 0x38, 0xe0,
            0x00, 0x38, 0xe0, 0x00, 0x38, 0xe0, 0x00, 0x38, 0xe0, 0x00, 0x38, 0xe0, 0x00, 0x38, 0xe0, 0x00,
            0x38, 0xe0, 0x00, 0x38, 0xe0, 0x00, 0x38, 0xe0, 0x00, 0x38, 0xe0, 0x00, 0x38, 0xe0, 0x00, 0x38,
            0xef, 0xff, 0xb8, 0x5f, 0xff, 0xd0, 0x0f, 0xff, 0xb8, 0x00, 0x00, 0x38, 0x00, 0x00, 0x38, 0x00,
            0x00, 0x38, 0x00, 0x00, 0x38, 0x00, 0x00, 0x38, 0x00, 0x00, 0x38, 0x00, 0x00, 0x38, 0x00, 0x00,
            0x38, 0x00, 0x00, 0x38, 0x00, 0x00, 0x38, 0x00, 0x00, 0x38, 0x00, 0x00, 0x38, 0x00, 0x00, 0x38,
            0x00, 0x00, 0x38, 0x00, 0x00, 0x10, 0x00, 0x00, 0x00, 0x00, 0x00, 0x00
        },
        {   // 5
            0x1f, 0xff, 0xc0, 0x3f, 0xff, 0xe0, 0x5f, 0xff, 0xc0, 0xe0, 0x00, 0x00, 0xe0, 0x00, 0x00, 0xe0,
            0x00, 0x00, 0xe0, 0x00, 0x00, 0xe0, 0x00, 0x00, 0xe0, 0x00, 0x00, 0xe0, 0x00, 0x00, 0xe0, 0x00,
            0x00, 0xe0, 0x00, 0x00, 0xe0, 0x00, 0x00, 0xe0, 0x00, 0x00, 0xe0, 0x00, 0x00, 0xe0, 0x00, 0x00,
            0xef, 0xff, 0x80, 0x5f, 0xff, 0xd0, 0x0f, 0xff, 0xb8, 0x00, 0x00, 0x38, 0x00, 0x00, 0x38, 0x00,
            0x00, 0x38, 0x00, 0x00, 0x38, 0x00, 0x00, 0x38, 0x00, 0x00, 0x38, 0x00, 0x00, 0x38, 0x00, 0x00,
            0x38, 0x00, 0x00, 0x38, 0x00, 0x00, 0x38, 0x00, 0x00, 0x38, 0x00, 0x00, 0x38, 0x00, 0x00, 0x38,
            0x00, 0x00, 0x38, 0x1f, 0xff, 0xd0, 0x3f, 0xff, 0xe0, 0x1f, 0xff, 0xc0
        },
        {   // 6
            0x1f, 0xff, 0xc0, 0x3f, 0xff, 0xe0, 0x5f, 0xff, 0xc0, 0xe0, 0x00, 0x00, 0xe0, 0x00, 0x00, 0xe0,
            0x00, 0x00, 0xe0, 0x00, 0x00, 0xe0, 0x00, 0x00, 0xe0, 0x00, 0x00, 0xe0, 0x00, 0x00, 0xe0, 0x00,
            0x00, 0xe0, 0x00, 0x00, 0xe0, 0x00, 0x00, 0xe0, 0x00, 0x00, 0xe0, 0x00, 0x00, 0xe0, 0x00, 0x00,
            0xef, 0xff, 0x80, 0x5f, 0xff, 0xd0, 0xef, 0xff, 0xb8, 0xe0, 0x00, 0x38, 0xe0, 0x00, 0x38, 0xe0,
            0x00, 0x38, 0xe0, 0x00, 0x38, 0xe0, 0x00, 0x38, 0xe0, 0x00, 0x38, 0xe0, 0x00, 0x38, 0xe0, 0x00,
            0x38, 0xe0, 0x00, 0x38, 0xe0, 0x00, 0x38, 0xe0, 0x00, 0x38, 0xe0, 0x00, 0x38, 0xe0, 0x00, 0x38,
            0xe0, 0x00, 0x38, 0x5f, 0xff, 0xd0, 0x3f, 0xff, 0xe0, 0x1f, 0xff, 0xc0
        },
        {   // 7
            0x1f, 0xff, 0xc0, 0x3f, 0xff, 0xe0, 0x1f, 0xff, 0xc0, 0x00, 0x00, 0x40, 0x00, 0x00, 0xc0, 0x00,
            0x00, 0xc0, 0x00, 0x01, 0x80, 0x00, 0x01, 0x80, 0x00, 0x03, 0x00, 0x00, 0x03, 0x00, 0x00, 0x06,
            0x00, 0x00, 0x06, 0x00, 0x00, 0x0c, 0x00, 0x00, 0x0c, 0x00, 0x00, 0x18, 0x00, 0x00, 0x18, 0x00,
            0x00, 0x30, 0x00, 0x00, 0x30, 0x00, 0x00, 0x30, 0x00, 0x00, 0x60, 0x00, 0x00, 0x60, 0x00, 0x00,
            0xc0, 0x00, 0x00, 0xc0, 0x00, 0x01, 0x80, 0x00, 0x01, 0x80, 0x00, 0x03, 0x00, 0x00, 0x03, 0x00,
            0x00, 0x06, 0x00, 0x00, 0x06, 0x00, 0x00, 0x0c, 0x00, 0x00, 0x0c, 0x00, 0x00, 0x18, 0x00, 0x00,
            0x18, 0x00, 0x00, 0x00, 0x00, 0x00, 0x00, 0x00, 0x00, 0x00, 0x00, 0x00
        },
        {   // 8
            0x1f, 0xff, 0xc0, 0x3f, 0xff, 0xe0, 0x5f, 0xff, 0xd0, 0xe0, 0x00, 0x38, 0xe0, 0x00, 0x38, 0xe0,
            0x00, 0x38, 0xe0, 0x00, 0x38, 0xe0, 0x00, 0x38, 0xe0, 0x00, 0x38, 0xe0, 0x00, 0x38, 0xe0, 0x00,
            0x38, 0xe0, 0x00, 0x38, 0xe0, 0x00, 0x38, 0xe0, 0x00, 0x38, 0xe0, 0x00, 0x38, 0xe0, 0x00, 0x38,
            0xef, 0xff, 0xb8, 0x5f, 0xff, 0xd0, 0xef, 0xff, 0xb8, 0xe0, 0x00, 0x38, 0xe0, 0x00, 0x38, 0xe0,
            0x00, 0x38, 0xe0, 0x00, 0x38, 0xe0, 0x00, 0x38, 0xe0, 0x00, 0x38, 0xe0, 0x00, 0x38, 0xe0, 0x00,
            0x38, 0xe0, 0x00, 0x38, 0xe0, 0x00, 0x38, 0xe0, 0x00, 0x38, 0xe0, 0x00, 0x38, 0xe0, 0x00, 0x38,
            0xe0, 0x00, 0x38, 0x5f, 0xff, 0xd0, 0x3f, 0xff, 0xe0, 0x1f, 0xff, 0xc0
        },
        {   // 9
            0x1f, 0xff, 0xc0, 0x3f, 0xff, 0xe0, 0x5f, 0xff, 0xd0, 0xe0, 0x00, 0x38, 0xe0, 0x00, 0x38, 0xe0,
            0x00, 0x38, 0xe0, 0x00, 0x38, 0xe0, 0x00, 0x38, 0xe0, 0x00, 0x38, 0xe0, 0x00, 0x38, 0xe0, 0x00,
            0x38, 0xe0, 0x00, 0x38, 0xe0, 0x00, 0x38, 0xe0, 0x00, 0x38, 0xe0, 0x00, 0x38, 0xe0, 0x00, 0x38,
            0xef, 0xff, 0xb8, 0x5f, 0xff, 0xd0, 0x0f, 0xff, 0xb8, 0x00, 0x00, 0x38, 0x00, 0x00, 0x38, 0x00,
            0x00, 0x38, 0x00, 0x00, 0x38, 0x00, 0x00, 0x38, 0x00, 0x00, 0x38, 0x00, 0x00, 0x38, 0x00, 0x00,
            0x38, 0x00, 0x00, 0x38, 0x00, 0x00, 0x38, 0x00, 0x00, 0x38, 0x00, 0x00, 0x38, 0x00, 0x00, 0x38,
            0x00, 0x00, 0x38, 0x1f, 0xff, 0xd0, 0x3f, 0xff, 0xe0, 0x1f, 0xff, 0xc0
        }
    };

    #define HEART_SMALL_WIDTH 12
    #define HEART_SMALL_HEIGHT 16
    static constexpr uint8_t lifeIcoSmall[] = {
        0xff, 0xf0, 0x80, 0x10, 0x80, 0x10, 0x80, 0x10, 0x90, 0x90, 0xb9, 0xd0, 0xbf, 0xd0, 0xbf, 0xd0,
        0xbf, 0xd0, 0x9f, 0x90, 0x8f, 0x10, 0x86, 0x10, 0x80, 0x10, 0x80, 0x10, 0x80, 0x10, 0xff, 0xf0
    };

    #define HEART_LARGE_WIDTH 16
    #define HEART_LARGE_HEIGHT 20
    static constexpr uint8_t lifeIcoLarge[] = {
        0xff, 0xff, 0xc0, 0x03, 0xbf, 0xfd, 0xa0, 0x05, 0xa0, 0x05, 0xa0, 0x05, 0xa4, 0x25, 0xae, 0x75, 
        0xaf, 0xf5, 0xaf, 0xf5, 0xaf, 0xf5, 0xa7, 0xe5, 0xa3, 0xc5, 0xa1, 0x85, 0xa0, 0x05, 0xa0, 0x05, 
        0xa0, 0x05, 0xbf, 0xfd, 0xc0, 0x03, 0xff, 0xff
    };

    #define LIFEBAR_BANNER_WIDTH 23
    #define LIFEBAR_BANNER_HEIGHT 9
    static constexpr uint8_t lifeBarBanner[] = {
        0xc1, 0xbf, 0x7e, 0xc1, 0xbf, 0x7e, 0xc1, 0xb8, 0x60, 0xc1, 0xb0, 0x60, 0xc1, 0xbe, 0x7c, 0xc1, 
        0xbe, 0x60, 0xc1, 0xb0, 0x60, 0xfd, 0xb0, 0x7e, 0xfd, 0xb0, 0x7e
    };

    #define LIFEBAR_SMALL_WIDTH 59
    #define LIFEBAR_SMALL_HEIGHT 9
    static constexpr uint8_t lifeBarSmall[] = {
        0x3f, 0xff, 0xff, 0xff, 0xff, 0xff, 0xff, 0x80, 0x7f, 0xff, 0xff, 0xff, 0xff, 0xff, 0xff, 0xc0, 
        0xc0, 0x00, 0x00, 0x00, 0x00, 0x00, 0x00, 0x60, 0xc0, 0x00, 0x00, 0x00, 0x00, 0x00, 0x00, 0x60, 
        0xc0, 0x00, 0x00, 0x00, 0x00, 0x00, 0x00, 0x60, 0xc0, 0x00, 0x00, 0x00, 0x00, 0x00, 0x00, 0x60, 
        0xc0, 0x00, 0x00, 0x00, 0x00, 0x00, 0x00, 0x60, 0x7f, 0xff, 0xff, 0xff, 0xff, 0xff, 0xff, 0xc0, 
        0x3f, 0xff, 0xff, 0xff, 0xff, 0xff, 0xff, 0x80
    };

    #define LIFEBAR_LARGE_WIDTH 106
    #define LIFEBAR_LARGE_HEIGHT 13
    static constexpr uint8_t lifeBarLarge[] = {
        0x1f, 0xff, 0xff, 0xff, 0xff, 0xff, 0xff, 0xff, 0xff, 0xff, 0xff, 0xff, 0xfe, 0x00, 0x3f, 0xff, 
        0xff, 0xff, 0xff, 0xff, 0xff, 0xff, 0xff, 0xff, 0xff, 0xff, 0xff, 0x00, 0x60, 0x00, 0x00, 0x00, 
        0x00, 0x00, 0x00, 0x00, 0x00, 0x00, 0x00, 0x00, 0x01, 0x80, 0xe0, 0x00, 0x00, 0x00, 0x00, 0x00, 
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        0xff, 0xff, 0xff, 0xff, 0xfe, 0x00
    };

    static constexpr uint8_t reloadGlyph[] = {
        // RELOAD
    };

    #define DIVIDER_WIDTH 1
    #define DIVIDER_HEIGHT 48
    // if only we could draw this vertically, sigh
    static constexpr uint8_t dividerLine[] = {
        0x40, 0x80, 0x00, 0x00, 0x80, 0x80, 0x00, 0x00, 0x80, 0x80, 0x00, 0x00, 0x80, 0x80, 0x00, 0x00, 
        0x80, 0x80, 0x00, 0x00, 0x80, 0x80, 0x00, 0x00, 0x80, 0x80, 0x00, 0x00, 0x80, 0x80, 0x00, 0x00, 
        0x80, 0x80, 0x00, 0x00, 0x80, 0x80, 0x00, 0x00, 0x80, 0x80, 0x00, 0x00, 0x80, 0x80, 0x00
    };

    #define ARROW_WIDTH 9
    #define ARROW_HEIGHT 5
    static constexpr uint8_t upArrowGlyph[] = {
        0x08, 0x00, 0x14, 0x00, 0x22, 0x00, 0x41, 0x00, 0x80, 0x80
    };

    static constexpr uint8_t downArrowGlyph[] = {
        0x80, 0x80, 0x41, 0x00, 0x22, 0x00, 0x14, 0x00, 0x08, 0x00
    };

    #define CONNECTION_WIDTH 10
    #define CONNECTION_HEIGHT 17
    static constexpr uint8_t btConnectIco[] = {
        0x18, 0x00, 0x1c, 0x00, 0x1e, 0x00, 0x1b, 0x00, 0xd9, 0x80, 0x78, 0xc0, 0x39, 0x80, 0x1b, 0x00, 
        0x1e, 0x00, 0x1b, 0x00, 0x39, 0x80, 0x78, 0xc0, 0xd9, 0x80, 0x1b, 0x00, 0x1e, 0x00, 0x1c, 0x00, 
        0x18, 0x00
    };

    static constexpr uint8_t usbConnectIco[] = {
        0x3f, 0x00, 0x2d, 0x00, 0x2d, 0x00, 0x2d, 0x00, 0x7f, 0x80, 0xc0, 0xc0, 0x88, 0x40, 0x9c, 0x40, 
        0x89, 0x40, 0xa9, 0x40, 0xaa, 0x40, 0xac, 0x40, 0x98, 0x40, 0x88, 0x40, 0x80, 0x40, 0xff, 0xc0, 
        0x7f, 0x80
    };

    #define GAMEPAD_WIDTH 18
    #define GAMEPAD_HEIGHT 12

    static constexpr uint8_t gamepadIco[] = {
        0x38, 0x07, 0x00, 0x7d, 0xef, 0x80, 0x42, 0x10, 0x80, 0x80, 0x00, 0x40, 0x91, 0x22, 0x40, 0xb8, 
        0x05, 0x40, 0x93, 0x32, 0x40, 0x84, 0xc8, 0x40, 0x84, 0xc8, 0x40, 0x87, 0x38, 0x40, 0x44, 0x08, 
        0x80, 0x38, 0x07, 0x00
    };

    #define MOUSE_WIDTH 16
    #define MOUSE_HEIGHT 13

    static constexpr uint8_t mouseIco[] = {
        0x06, 0x00, 0x09, 0x03, 0x10, 0x84, 0x7c, 0x48, 0x92, 0x48, 0x92, 0x30, 0x92, 0x00, 0xfe, 0x00, 
        0x82, 0x00, 0x82, 0x00, 0x82, 0x00, 0x44, 0x00, 0x38, 0x00
    };

    #define MAMEHOOK_WIDTH 21
    #define MAMEHOOK_HEIGHT 16

    static constexpr uint8_t mamehookIco[] = {
        0x00, 0x02, 0x08, 0x00, 0x06, 0x18, 0x00, 0x0e, 0x38, 0x00, 0x1a, 0x68, 0x00, 0x32, 0xc8, 0x00, 
        0x63, 0x88, 0x00, 0xc3, 0x08, 0x01, 0x82, 0x08, 0x03, 0x00, 0x08, 0x06, 0x10, 0x08, 0x0c, 0x30, 
        0x88, 0x18, 0x71, 0x88, 0x30, 0xb3, 0x88, 0x61, 0x35, 0x88, 0xc2, 0x39, 0x88, 0xfc, 0x31, 0xf8
    };

    #define MISTERKUN_WIDTH 32
    #define MISTERKUN_HEIGHT 31

    static constexpr uint8_t misterIco[] = {
        0x00, 0x40, 0x02, 0x00, 0x00, 0xa0, 0x05, 0x00, 0x01, 0x50, 0x0a, 0x80, 0x02, 0xa8, 0x15, 0x40, 
        0x05, 0xf7, 0xef, 0xa0, 0x08, 0x00, 0x00, 0x10, 0x08, 0x00, 0x00, 0x10, 0x10, 0x00, 0x00, 0x08, 
        0x10, 0x00, 0x00, 0x08, 0x10, 0x00, 0x00, 0x08, 0x10, 0x00, 0x00, 0x08, 0x10, 0x04, 0x20, 0x08, 
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        0x40, 0x08, 0x10, 0x02, 0x20, 0x08, 0x10, 0x04, 0x1f, 0xf0, 0x0f, 0xf8
    };

    #define CUSTSPLASHBANN_WIDTH 80
    #define CUSTSPLASHBANN_HEIGHT 16
    static constexpr uint8_t customSplashBanner[] = {
        0x07, 0x00, 0x00, 0x00, 0x00, 0x03, 0xfe, 0xef, 0xf1, 0xff, 0x1f, 0xc0, 0x00, 0x00, 0x00, 0x03, 
        0xfe, 0xef, 0xf9, 0xff, 0x3f, 0xe0, 0x00, 0x00, 0x00, 0x03, 0xfe, 0xef, 0xf9, 0xc0, 0x7a, 0xf0, 
        0x00, 0x00, 0x00, 0x03, 0x80, 0xee, 0x1d, 0xc0, 0x72, 0x73, 0xfc, 0x1f, 0x8f, 0xf3, 0x80, 0xee, 
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        0x00, 0x00, 0x00, 0x00, 0x00, 0x00, 0x00, 0x03, 0x80, 0x00, 0x00, 0x00, 0x00, 0x00, 0x00, 0x00
    };

    #define CUSTSPLASH_WIDTH  48
    #define CUSTSPLASH_HEIGHT 48
    static constexpr uint8_t customSplash[] = {
        0x00, 0x00, 0x03, 0xc0, 0x00, 0x00, 0x00, 0x00, 0x03, 0xc0, 0x00, 0x00, 0x00, 0x00, 0x03, 0xc0, 
        0x00, 0x00, 0x00, 0x00, 0x0f, 0xf0, 0x00, 0x00, 0x00, 0x00, 0xff, 0xff, 0x00, 0x00, 0x00, 0x03, 
        0xff, 0xff, 0xc0, 0x00, 0x00, 0x07, 0xf8, 0x1f, 0xf0, 0x00, 0x00, 0x1f, 0xc0, 0x03, 0xf8, 0x00, 
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        0x03, 0xc0, 0x00, 0x00, 0x00, 0x00, 0x03, 0xc0, 0x00, 0x00, 0x00, 0x00, 0x03, 0xc0, 0x00, 0x00
    };
};

#endif // _OPENFIREDISPLAY_H_
